	LIST P=16F877A
	#INCLUDE <P16F877A.INC>
	__CONFIG H'3F31'
	SAYICI1	 EQU 0X20
	SAYICI2	 EQU 0X21
	LCD_DEG EQU 0X22
	ONLAR	EQU 0X23
	BIRLER	EQU 0X24
	YUZLER	 EQU 0X25
	BSM_ONLAR EQU 0X26
	BSM_BIRLER EQU 0X27
	BSM_YUZLER EQU 0X28
	DEG EQU 0X29
	DEG2 EQU 0X30
	SAYAC EQU 0X31
	SAYAC2 EQU 0X32
	SAYACTIMER EQU 0X33

	ORG 0X000
	GOTO ANA_METOT
	ORG 0X004
	GOTO KESME_METOT
		
ANA_METOT
	BANKSEL TRISB	
	CLRF TRISB	
	MOVLW 0X06
	MOVWF ADCON1
	MOVLW B'00000011'
	MOVWF TRISA
	BANKSEL T1CON
	MOVLW B'00010001'
	MOVWF T1CON
	BANKSEL PIR1
	BCF PIR1,TMR1IF
	BANKSEL PIE1
	BSF PIE1,TMR1IE
	BANKSEL INTCON
	MOVLW B'11000000'
	MOVWF INTCON	
	BANKSEL PORTB
	CLRF PORTB
	CLRF ONLAR
	CLRF BIRLER
	CLRF YUZLER
	CLRF SAYAC
	CLRF SAYAC2
	CLRF DEG
	MOVLW D'100'
	MOVWF DEG2 
	MOVLW 0XB0
	MOVWF TMR1L
	MOVLW 0X3C
	MOVWF TMR1H
	MOVLW D'5'
	MOVWF SAYACTIMER
	
KONTROL
	BTFSC PORTA,0
	GOTO ARTIR_METOT
	BTFSC PORTA,1
	GOTO AZALT_METOT
	GOTO KONTROL
	
KARAKTER_YAZ					;LCD'ye karakter göndermek için 
	MOVWF LCD_DEG			;Komutu geçici deðiþkene al.
	SWAPF LCD_DEG, W		;En deðerli 4 bit’i gönder.
	CALL LCD_KARAKTER_GONDER
	MOVF LCD_DEG, W		;En deðersiz 4 bit’i gönder.
	CALL LCD_KARAKTER_GONDER
	RETURN

LCD_KARAKTER_GONDER                     
	ANDLW 0x0F				;En deðersiz 4 bit W'de
	MOVWF PORTB 			;PortB'e transfer ediliyor.
	BANKSEL PORTB 			
	BSF PORTB,4				;Karakter Yazýlacaðý belirtiliyor
	BSF	PORTB,5			;LCD'için 1 yapýlýr
	CALL GECIKME
	BCF	PORTB,5				;LCD için düþen kenar üretiyorz
	RETURN

KOMUT_YAZ       	
	MOVWF LCD_DEG		 	;Komutu geçici deðiþkene al.
	SWAPF LCD_DEG, W   	;En deðerli 4 bit’i gönder.
	CALL LCD_KOMUT_GONDER
	MOVF LCD_DEG, W		;En deðersiz 4 bit’i gönder.
	CALL LCD_KOMUT_GONDER		
	RETURN

LCD_KOMUT_GONDER                    
	ANDLW	0x0F			;En deðersiz 4 bit W'de,
	MOVWF PORTB 			;PortB'ye transfer ediliyor.
	BANKSEL PORTB
	BCF PORTB,4 			
	BSF	PORTB,5				;Lcd ye düþen kenar üretmek için 
	CALL GECIKME
	BCF	PORTB,5				;LCD için düþen kenar üretiyorz
	RETURN
	
KESME_METOT
	BANKSEL PIR1
	BCF PIR1,TMR1IF

	DECFSZ SAYACTIMER,F
	RETFIE

	MOVLW D'5'
	MOVWF SAYACTIMER

	MOVF DEG,W
	MOVWF SAYAC
	INCF SAYAC,F
	MOVF SAYAC,W
	MOVWF DEG
	CLRF BIRLER
	CLRF ONLAR
	CLRF YUZLER
	
	CALL KONTROL_STR1

SONLANDIR_METOT
	MOVLW 0XB0
	MOVWF TMR1L
	MOVLW 0X3C
	MOVWF TMR1H
	RETFIE

KONTROL_STR1

D1	
	MOVLW D'100'
	SUBWF SAYAC,F
	BTFSS STATUS,C
	GOTO KONTROL_STR2
	INCF YUZLER,F
	GOTO D1	
KONTROL_STR2 
	MOVLW D'100'
	ADDWF SAYAC,F

D2	
	MOVLW D'10'
	SUBWF SAYAC,F
	BTFSS STATUS,C
	GOTO KONTROL_STR3
	INCF ONLAR,F
	GOTO D2
KONTROL_STR3
	MOVLW D'10'
	ADDWF SAYAC,F

D3
	MOVLW D'1'
	SUBWF SAYAC,F
	BTFSS STATUS,C
	GOTO LCD_AYARLAR
	INCF BIRLER,F
	GOTO D3

LCD_AYARLAR
	MOVLW	H'02'
	CALL KOMUT_YAZ
	MOVLW	H'0C'
	CALL	KOMUT_YAZ
	MOVLW H'28'
	CALL KOMUT_YAZ

	CALL SATIR1_AYARLAR
	
	MOVLW D'48'
	ADDWF YUZLER,W
	CALL KARAKTER_YAZ
	
	MOVLW D'48'
	ADDWF ONLAR,W
	CALL KARAKTER_YAZ
	
	MOVLW D'48'
	ADDWF BIRLER,W
	CALL KARAKTER_YAZ
	GOTO SONLANDIR_METOT
	
	RETFIE

SATIR2_AYARLAR
	MOVLW	H'C0'
	CALL	KOMUT_YAZ
	RETURN

SATIR1_AYARLAR
	MOVLW	H'80'
	CALL	KOMUT_YAZ
	RETURN

AZALT_METOT
	MOVF DEG2,W
	MOVWF SAYAC2
	DECF SAYAC2,F
	MOVF SAYAC2,W
	MOVWF DEG2
	GOTO KONTROL_STR1BUTON

ARTIR_METOT
	MOVF DEG2,W
	MOVWF SAYAC2
	INCF SAYAC2,F
	MOVF SAYAC2,W
	MOVWF DEG2
	
	GOTO KONTROL_STR1BUTON

KONTROL_STR1BUTON
	CLRF BSM_BIRLER
	CLRF BSM_ONLAR
	CLRF BSM_YUZLER

BUTOND1
	
	MOVLW D'100'
	SUBWF SAYAC2,F
	BTFSS STATUS,C
	GOTO KONTROL_STR1BUTON2
	INCF BSM_YUZLER,F
	GOTO BUTOND1	

KONTROL_STR1BUTON2 
	MOVLW D'100'
	ADDWF SAYAC2,F

BUTOND2	
	MOVLW D'10'
	SUBWF SAYAC2,F
	BTFSS STATUS,C
	GOTO KONTROL_STR1BUTON3
	INCF BSM_ONLAR,F
	GOTO BUTOND2

KONTROL_STR1BUTON3
	MOVLW D'10'
	ADDWF SAYAC2,F

BUTOND3	
	MOVLW D'1'
	SUBWF SAYAC2,F
	BTFSS STATUS,C
	GOTO LCD_AYARLAR2
	INCF BSM_BIRLER,F
	GOTO BUTOND3

LCD_AYARLAR2
	CALL GECIKME
	BANKSEL INTCON
	BCF INTCON,GIE

	MOVLW	H'84'
	CALL	KOMUT_YAZ
	CALL SATIR2_AYARLAR
	MOVLW D'48'
	ADDWF BSM_YUZLER,W
	CALL KARAKTER_YAZ
	
	MOVLW D'48'
	ADDWF BSM_ONLAR,W
	CALL KARAKTER_YAZ
	
	MOVLW D'48'
	ADDWF BSM_BIRLER,W
	CALL KARAKTER_YAZ
	BANKSEL INTCON
	BSF INTCON,GIE
	GOTO KONTROL

GECIKME
	MOVLW	D'60'
	MOVWF	SAYICI1
TEKRAR1
	MOVLW	D'130'
	MOVWF	SAYICI2
TEKRAR2
	DECFSZ	SAYICI2,F
	GOTO	TEKRAR2
	DECFSZ	SAYICI1,F
	GOTO	TEKRAR1
	RETURN
		
	END
		 
